/*
 * Copyright (c) 2025 Nordic Semiconductor ASA
 *
 * SPDX-License-Identifier: LicenseRef-Nordic-5-Clause
 */

#include "../boards/memory_map.overlay"

/{
	chosen {
		zephyr,code-partition = &cpurad_loaded_fw_slot1;
		zephyr,sram = &cpurad_ram0;
		// fw-to-relocate = &cpurad_loaded_fw_slot1;
	};
};

&cpurad_ram0 {
	compatible = "mmio-sram";
	/delete-property/ reg;
	reg = < 0x23000000 (DT_SIZE_K(192)) >;
	ranges = < 0x0 0x23000000 (DT_SIZE_K(192)) >;
};

secondary_app_partition: &cpurad_loaded_fw_slot1 {};
