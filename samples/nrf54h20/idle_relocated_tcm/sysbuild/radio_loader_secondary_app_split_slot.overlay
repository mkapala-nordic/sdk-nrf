/*
 * Copyright (c) 2025 Nordic Semiconductor ASA
 *
 * SPDX-License-Identifier: LicenseRef-Nordic-5-Clause
 */

#include "../boards/memory_map_split_slot.dtsi"
#include "../boards/memory_map_ram_cpurad.dtsi"

/{
	chosen {
		zephyr,sram = &cpurad_loader_ram;
		zephyr,loaded-fw-src = &cpurad_loaded_fw_slot1;
		zephyr,loaded-fw-dst = &cpurad_ram0;
	};
};

secondary_app_partition: &cpurad_loader_partition_slot1 {};
