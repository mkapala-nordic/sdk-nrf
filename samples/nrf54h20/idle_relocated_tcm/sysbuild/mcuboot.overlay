/*
 * Copyright (c) 2025 Nordic Semiconductor ASA
 *
 * SPDX-License-Identifier: LicenseRef-Nordic-5-Clause
 */

#include "../boards/memory_map.overlay"

/ {
	chosen {
		zephyr,code-partition = &boot_partition;
	};
};

&cpurad_ram0 {
	compatible = "mmio-sram";
	/delete-property/ reg;
	reg = < 0x23000000 (DT_SIZE_K(188)) >;
	ranges = < 0x0 0x23000000 (DT_SIZE_K(188)) >;
};
