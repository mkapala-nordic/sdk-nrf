## samples/bluetooth/fast_pair/input_device/boards/nrf54l15pdk_nrf54l15_cpuapp.conf
```kconfig
CONFIG_PM_SINGLE_IMAGE=n

CONFIG_DK_LIBRARY_BUTTON_NO_ISR=y

# Enable nordic security backend and PSA APIs
CONFIG_NRF_SECURITY=y
CONFIG_PSA_WANT_GENERATE_RANDOM=y
```

## samples/bluetooth/fast_pair/locator_tag/src/Kconfig.dfu
```kconfig
#
# Copyright (c) 2024 Nordic Semiconductor
#
# SPDX-License-Identifier: LicenseRef-Nordic-5-Clause
#

config APP_DFU
        bool "MCUmgr & SMP BT DFU support"
        select MCUMGR
	select NET_BUF
	select ZCBOR
	select CRC
	select MCUMGR_TRANSPORT_BT
	imply MCUMGR_TRANSPORT_BT_CONN_PARAM_CONTROL
	imply IMG_MANAGER
	imply STREAM_FLASH
	imply FLASH_MAP
	imply FLASH
	imply MCUMGR_GRP_IMG
	imply MCUMGR_GRP_OS
	imply MCUMGR_GRP_OS_BOOTLOADER_INFO
	imply MCUMGR_TRANSPORT_BT_REASSEMBLY
	imply MCUMGR_MGMT_NOTIFICATION_HOOKS
	imply MCUMGR_SMP_COMMAND_STATUS_HOOKS
        depends on BOOTLOADER_MCUBOOT
        help
          Enable support for Device Firmware Update (DFU) over MCUmgr & SMP BT.

if APP_DFU

config MCUMGR_TRANSPORT_BT_DYNAMIC_SVC_REGISTRATION
        default n

config MCUMGR_TRANSPORT_BT_AUTHEN
	default n

config IMG_ERASE_PROGRESSIVELY
	default y

if MCUMGR_TRANSPORT_BT_REASSEMBLY

config MCUMGR_TRANSPORT_NETBUF_SIZE
	default 2475

config MCUMGR_GRP_OS_MCUMGR_PARAMS
	default y

endif # MCUMGR_TRANSPORT_BT_REASSEMBLY

config BT_L2CAP_TX_MTU
	default 498 if BT_HCI_HOST

config BT_BUF_ACL_TX_SIZE
	default 251

config BT_BUF_ACL_RX_SIZE
	default 502

config BT_CTLR_DATA_LENGTH_MAX
	default 251 if BT_CTLR

endif # APP_DFU
```

## samples/bluetooth/fast_pair/locator_tag/sysbuild/mcuboot/boards/nrf54l15pdk_nrf54l15_cpuapp.conf
```kconfig
#
# Copyright (c) 2024 Nordic Semiconductor
#
# SPDX-License-Identifier: LicenseRef-Nordic-4-Clause
#

CONFIG_BOOT_MAX_IMG_SECTORS=256

# Fprotect is currently not supported.
CONFIG_FPROTECT=n
```

## samples/bluetooth/fast_pair/locator_tag/sysbuild/mcuboot/boards/thingy53_nrf5340_cpuapp.conf
```kconfig
#
# Copyright (c) 2023 Nordic Semiconductor
#
# SPDX-License-Identifier: LicenseRef-Nordic-4-Clause
#

CONFIG_BOOT_MAX_IMG_SECTORS=2048

# Required for kernel operation
CONFIG_CLOCK_CONTROL=y
CONFIG_SYS_CLOCK_EXISTS=y
CONFIG_NRF_RTC_TIMER=y

# Disable logs regardless of the build configuration
CONFIG_BOOT_BANNER=n
CONFIG_NCS_BOOT_BANNER=n
CONFIG_NCS_APPLICATION_BOOT_BANNER_STRING=""
CONFIG_LOG=n
CONFIG_CONSOLE=n
CONFIG_CONSOLE_HANDLER=n
CONFIG_PRINTK=n
CONFIG_SERIAL=n
CONFIG_UART_CONSOLE=n
CONFIG_BOARD_SERIAL_BACKEND_CDC_ACM=n

# Required by QSPI
CONFIG_MULTITHREADING=y

# Required by QSPI
CONFIG_NORDIC_QSPI_NOR=y
CONFIG_NORDIC_QSPI_NOR_FLASH_LAYOUT_PAGE_SIZE=4096
CONFIG_NORDIC_QSPI_NOR_STACK_WRITE_BUFFER_SIZE=16

# The following configurations are required to support simultaneous multi image update
CONFIG_PCD_APP=y

# The network core cannot access external flash directly. The flash simulator must be used to
# provide a memory region that is used to forward the new firmware to the network core.
CONFIG_FLASH_SIMULATOR=y
CONFIG_FLASH_SIMULATOR_DOUBLE_WRITES=y
CONFIG_FLASH_SIMULATOR_STATS=n
```
