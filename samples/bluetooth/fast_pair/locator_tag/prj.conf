## CMakeLists.txt
```
#
# Copyright (c) 2024 Nordic Semiconductor
#
# SPDX-License-Identifier: LicenseRef-Nordic-5-Clause
#
cmake_minimum_required(VERSION 3.20.0)

if(NOT DEFINED FP_MODEL_ID AND NOT DEFINED FP_ANTI_SPOOFING_KEY AND NOT SYSBUILD)
  message(WARNING "
  -------------------------------------------------------
  --- WARNING: Using demo Fast Pair Model ID and Fast ---
  --- Pair Anti Spoofing Key, it should not be used   ---
  --- for production.                                 ---
  -------------------------------------------------------
  \n"
  )
  set(FP_MODEL_ID "0x4A436B")
  set(FP_ANTI_SPOOFING_KEY "rie10A7ONqwd77VmkxGsblPUbMt384qjDgcEJ/ctT9Y=")
endif()

find_package(Zephyr REQUIRED HINTS $ENV{ZEPHYR_BASE})
project(locator_tag)

# NORDIC SDK APP START
target_sources(app PRIVATE
  src/main.c
  src/factory_reset.c
  src/fp_adv.c
  src/smp_adv_prov.c
)

if (NOT CONFIG_BT_FAST_PAIR_FMDN_RING_COMP_NONE)
  target_sources(app PRIVATE src/ring.c)
endif()

target_include_directories(app PRIVATE include)

add_subdirectory(src/ui)
target_link_libraries(app PRIVATE app_ui)

add_subdirectory(src/battery)
target_link_libraries(app PRIVATE app_battery)
# NORDIC SDK APP END
```

## Kconfig.sysbuild
```
#
# Copyright (c) 2024 Nordic Semiconductor
#
# SPDX-License-Identifier: LicenseRef-Nordic-5-Clause
#

# TODO: ADD REMAINING sysbuild.conf files!!!

# config BT_FAST_PAIR
# 	default y

# config NRF_DEFAULT_IPC_RADIO
# 	default y

# choice BOOTLOADER
# 	default BOOTLOADER_MCUBOOT
# endchoice

# choice MCUBOOT_MODE
# 	default MCUBOOT_MODE_DIRECT_XIP if (SOC_SERIES_NRF52X || SOC_SERIES_NRF54LX)
# endchoice

config APP_DFU
	bool "Enable DFU over MCUmgr & SMP BT"
	default y
	depends on BOOTLOADER_MCUBOOT

source "${ZEPHYR_BASE}/share/sysbuild/Kconfig"
```

## sysbuild.conf
```
#
# Copyright (c) 2024 Nordic Semiconductor
#
# SPDX-License-Identifier: LicenseRef-Nordic-5-Clause
#

# SB_CONFIG_BT_FAST_PAIR=y
```

## prj.conf
```kconfig
#
# Copyright (c) 2024 Nordic Semiconductor
#
# SPDX-License-Identifier: LicenseRef-Nordic-5-Clause
#

CONFIG_NCS_SAMPLES_DEFAULTS=y

CONFIG_MAIN_STACK_SIZE=2048
CONFIG_SYSTEM_WORKQUEUE_PRIORITY=-1

CONFIG_DK_LIBRARY=y

CONFIG_LOG=y

# Error handling configuration
CONFIG_RESET_ON_FATAL_ERROR=n

# Enable settings to store data in non-volatile memory
CONFIG_FLASH=y
CONFIG_FLASH_MAP=y
CONFIG_NVS=y
CONFIG_SETTINGS_NVS=y
CONFIG_SETTINGS=y
CONFIG_BT_SETTINGS=y

CONFIG_BT=y
CONFIG_BT_DEVICE_NAME="NCS locator tag"
CONFIG_BT_PERIPHERAL=y
CONFIG_BT_PERIPHERAL_PREF_MIN_INT=24
CONFIG_BT_PERIPHERAL_PREF_MAX_INT=40
CONFIG_BT_PERIPHERAL_PREF_LATENCY=0
CONFIG_BT_PERIPHERAL_PREF_TIMEOUT=100
CONFIG_BT_CONN_PARAM_UPDATE_TIMEOUT=500

CONFIG_BT_ADV_PROV=y
CONFIG_BT_ADV_PROV_FLAGS=y
CONFIG_BT_ADV_PROV_TX_POWER=y
CONFIG_BT_ADV_PROV_FAST_PAIR=y
CONFIG_BT_ADV_PROV_DEVICE_NAME=y
CONFIG_BT_ADV_PROV_DEVICE_NAME_SD=y

# Disable automatic initiation of PHY updates.
# Workaround to prevent disconnection with reason 42 (BT_HCI_ERR_DIFF_TRANS_COLLISION).
# Some Android phones reply to the LL_PHY_REQ and at the same time initiate a connection
# update which triggers an invalid procedure collision.
CONFIG_BT_AUTO_PHY_UPDATE=n

CONFIG_BT_ID_MAX=2
CONFIG_BT_MAX_PAIRED=8
CONFIG_BT_SMP=y
CONFIG_BT_PRIVACY=y
CONFIG_BT_GATT_AUTHORIZATION_CUSTOM=y
CONFIG_BT_RPA_TIMEOUT_DYNAMIC=y
CONFIG_BT_MAX_CONN=3
CONFIG_BT_EXT_ADV_MAX_ADV_SET=2

CONFIG_BT_FAST_PAIR=y
CONFIG_BT_FAST_PAIR_REQ_PAIRING=n
CONFIG_BT_FAST_PAIR_LOG_LEVEL_DBG=y
CONFIG_BT_FAST_PAIR_STORAGE_USER_RESET_ACTION=y
CONFIG_BT_FAST_PAIR_FMDN=y
CONFIG_BT_FAST_PAIR_FMDN_BATTERY_DULT=y
CONFIG_BT_FAST_PAIR_FMDN_RING_COMP_THREE=y
CONFIG_BT_FAST_PAIR_FMDN_RING_VOLUME=y
CONFIG_BT_FAST_PAIR_FMDN_CLOCK_NVM_UPDATE_TIME=10

CONFIG_BT_FAST_PAIR_FMDN_DULT_MANUFACTURER_NAME="Nordic Semiconductor ASA"
CONFIG_BT_FAST_PAIR_FMDN_DULT_MODEL_NAME="NCS locator tag"
# Set Location Tracker Accessory Category.
CONFIG_BT_FAST_PAIR_FMDN_DULT_ACCESSORY_CATEGORY=1

CONFIG_DULT_LOG_LEVEL_DBG=y

# Firmware versions should be aligned.
# Major.Minor.Revision value of 0.0.0 is not supported by the Fast Pair Validator
# Android app.
CONFIG_BT_FAST_PAIR_FMDN_DULT_FIRMWARE_VERSION_MAJOR=1
CONFIG_BT_FAST_PAIR_FMDN_DULT_FIRMWARE_VERSION_MINOR=0
CONFIG_BT_FAST_PAIR_FMDN_DULT_FIRMWARE_VERSION_REVISION=0
CONFIG_MCUBOOT_IMGTOOL_SIGN_VERSION="1.0.0+0"

# Align the TX power encoded in the Fast Pair advertising set and
# the Read Beacon Parameters response with Fast Pair expectations.
# The value has been tailored for following DKs:
#   * nrf52dk/nrf52832
#   * nrf52833dk/nrf52833
#   * nrf52840dk/nrf52840
#   * nrf5340dk/nrf5340/cpuapp(/ns)
CONFIG_BT_ADV_PROV_TX_POWER_CORRECTION_VAL=-14
CONFIG_BT_FAST_PAIR_FMDN_TX_POWER_CORRECTION_VAL=-14
```

## dfu_speedup_netcore_fragment.conf
```kconfig
#
# Copyright (c) 2024 Nordic Semiconductor
#
# SPDX-License-Identifier: LicenseRef-Nordic-5-Clause
#

# Align buffers according to the src/Kconfig.dfu settings
CONFIG_BT_BUF_ACL_TX_SIZE=251
CONFIG_BT_BUF_ACL_RX_SIZE=502
CONFIG_BT_CTLR_DATA_LENGTH_MAX=251
```

## prj_release.conf
```kconfig
#
# Copyright (c) 2024 Nordic Semiconductor
#
# SPDX-License-Identifier: LicenseRef-Nordic-5-Clause
#

CONFIG_MAIN_STACK_SIZE=2048
CONFIG_SYSTEM_WORKQUEUE_PRIORITY=-1

CONFIG_DK_LIBRARY=y

# Error handling configuration
CONFIG_RESET_ON_FATAL_ERROR=y

# Activate LTO
CONFIG_LTO=y
CONFIG_ISR_TABLES_LOCAL_DECLARATION=y

# Memory optimization
CONFIG_SERIAL=n
CONFIG_CONSOLE=n
CONFIG_PRINTK=n
CONFIG_UART_CONSOLE=n
CONFIG_USE_SEGGER_RTT=n
CONFIG_BOOT_BANNER=n
CONFIG_NCS_BOOT_BANNER=n
CONFIG_BT_ASSERT=n
CONFIG_ASSERT_VERBOSE=n
CONFIG_HW_STACK_PROTECTION=n
CONFIG_SETTINGS_DYNAMIC_HANDLERS=n

# Enable settings to store data in non-volatile memory
CONFIG_FLASH=y
CONFIG_FLASH_MAP=y
CONFIG_NVS=y
CONFIG_SETTINGS_NVS=y
CONFIG_SETTINGS=y
CONFIG_BT_SETTINGS=y

CONFIG_BT=y
CONFIG_BT_DEVICE_NAME="NCS locator tag"
CONFIG_BT_PERIPHERAL=y
CONFIG_BT_PERIPHERAL_PREF_MIN_INT=24
CONFIG_BT_PERIPHERAL_PREF_MAX_INT=40
CONFIG_BT_PERIPHERAL_PREF_LATENCY=0
CONFIG_BT_PERIPHERAL_PREF_TIMEOUT=100
CONFIG_BT_CONN_PARAM_UPDATE_TIMEOUT=500

CONFIG_BT_ADV_PROV=y
CONFIG_BT_ADV_PROV_FLAGS=y
CONFIG_BT_ADV_PROV_TX_POWER=y
CONFIG_BT_ADV_PROV_FAST_PAIR=y
CONFIG_BT_ADV_PROV_DEVICE_NAME=y
CONFIG_BT_ADV_PROV_DEVICE_NAME_SD=y

# Disable automatic initiation of PHY updates.
# Workaround to prevent disconnection with reason 42 (BT_HCI_ERR_DIFF_TRANS_COLLISION).
# Some Android phones reply to the LL_PHY_REQ and at the same time initiate a connection
# update which triggers an invalid procedure collision.
CONFIG_BT_AUTO_PHY_UPDATE=n

CONFIG_BT_ID_MAX=2
CONFIG_BT_MAX_PAIRED=8
CONFIG_BT_SMP=y
CONFIG_BT_PRIVACY=y
CONFIG_BT_GATT_AUTHORIZATION_CUSTOM=y
CONFIG_BT_RPA_TIMEOUT_DYNAMIC=y
CONFIG_BT_MAX_CONN=3
CONFIG_BT_EXT_ADV_MAX_ADV_SET=2

CONFIG_BT_FAST_PAIR=y
CONFIG_BT_FAST_PAIR_REQ_PAIRING=n
CONFIG_BT_FAST_PAIR_STORAGE_USER_RESET_ACTION=y
CONFIG_BT_FAST_PAIR_FMDN=y
CONFIG_BT_FAST_PAIR_FMDN_BATTERY_DULT=y
CONFIG_BT_FAST_PAIR_FMDN_RING_COMP_THREE=y
CONFIG_BT_FAST_PAIR_FMDN_RING_VOLUME=y
CONFIG_BT_FAST_PAIR_FMDN_CLOCK_NVM_UPDATE_TIME=10

CONFIG_BT_FAST_PAIR_FMDN_DULT_MANUFACTURER_NAME="Nordic Semiconductor ASA"
CONFIG_BT_FAST_PAIR_FMDN_DULT_MODEL_NAME="NCS locator tag"
# Set Location Tracker Accessory Category.
CONFIG_BT_FAST_PAIR_FMDN_DULT_ACCESSORY_CATEGORY=1

# Firmware versions should be aligned.
# Major.Minor.Revision value of 0.0.0 is not supported by the Fast Pair Validator
# Android app.
CONFIG_BT_FAST_PAIR_FMDN_DULT_FIRMWARE_VERSION_MAJOR=1
CONFIG_BT_FAST_PAIR_FMDN_DULT_FIRMWARE_VERSION_MINOR=0
CONFIG_BT_FAST_PAIR_FMDN_DULT_FIRMWARE_VERSION_REVISION=0
CONFIG_MCUBOOT_IMGTOOL_SIGN_VERSION="1.0.0+0"

# Align the TX power encoded in the Fast Pair advertising set and
# the Read Beacon Parameters response with Fast Pair expectations.
# The value has been tailored for following DKs:
#   * nrf52dk/nrf52832
#   * nrf52833dk/nrf52833
#   * nrf52840dk/nrf52840
#   * nrf5340dk/nrf5340/cpuapp(/ns)
CONFIG_BT_ADV_PROV_TX_POWER_CORRECTION_VAL=-14
CONFIG_BT_FAST_PAIR_FMDN_TX_POWER_CORRECTION_VAL=-14
```

## boards/nrf5340dk_nrf5340_cpuapp_ns.conf
```kconfig
#
# Copyright (c) 2024 Nordic Semiconductor ASA
#
# SPDX-License-Identifier: LicenseRef-Nordic-5-Clause
#

# For external flash and network core update the MCUboot need whole RAM as
# secure part is not enough.
# Needed so that the Partition Manager can reserve the correct amount of RAM.
CONFIG_MCUBOOT_USE_ALL_AVAILABLE_RAM=y
```

## boards/nrf5340dk_nrf5340_cpuapp_ns_release.conf
```kconfig
#
# Copyright (c) 2024 Nordic Semiconductor ASA
#
# SPDX-License-Identifier: LicenseRef-Nordic-5-Clause
#

# For external flash and network core update the MCUboot need whole RAM as
# secure part is not enough.
# Needed so that the Partition Manager can reserve the correct amount of RAM.
CONFIG_MCUBOOT_USE_ALL_AVAILABLE_RAM=y

# Disable TF-M logging
CONFIG_TFM_LOG_LEVEL_SILENCE=y
```

## boards/thingy53_nrf5340_cpuapp_ns_release.conf
```kconfig
#
# Copyright (c) 2024 Nordic Semiconductor ASA
#
# SPDX-License-Identifier: LicenseRef-Nordic-5-Clause
#

CONFIG_SYSTEM_WORKQUEUE_STACK_SIZE=4096

# Disable logging in the release configuration
CONFIG_BOARD_SERIAL_BACKEND_CDC_ACM=n

# Enable the Zephyr drivers required by the speaker and battery module.
CONFIG_PWM=y
CONFIG_ADC=y

# Adjust the FMDN ringing configuration to align it with the platform`s capabilities.
CONFIG_BT_FAST_PAIR_FMDN_RING_COMP_ONE=y
CONFIG_BT_FAST_PAIR_FMDN_RING_VOLUME=n

# Adjust the DULT configuration to align it with the platform`s capabilities.
CONFIG_DULT_BATTERY_TYPE_RECHARGEABLE=y

# Align the TX power encoded in the Fast Pair advertising set and
# the Read Beacon Parameters response with Fast Pair expectations.
# The value has been tailored for the following targets:
#   * thingy53/nrf5340/cpuapp(/ns)
CONFIG_BT_ADV_PROV_TX_POWER_CORRECTION_VAL=-10
CONFIG_BT_FAST_PAIR_FMDN_TX_POWER_CORRECTION_VAL=-10

# Disable TF-M logging
CONFIG_TFM_LOG_LEVEL_SILENCE=y
```

## boards/nrf5340dk_nrf5340_cpuapp_ns.overlay
```dts
/*
 * Copyright (c) 2024 Nordic Semiconductor ASA
 *
 * SPDX-License-Identifier: LicenseRef-Nordic-4-Clause
 */

/ {
	chosen {
		nordic,pm-ext-flash = &mx25r64;
	};
};
```

## src/main.c
```c
/*
 * Copyright (c) 2024 Nordic Semiconductor ASA
 *
 * SPDX-License-Identifier: LicenseRef-Nordic-5-Clause
 */

#include <zephyr/settings/settings.h>
#include <zephyr/kernel.h>

#include <zephyr/bluetooth/conn.h>
#include <zephyr/bluetooth/gatt.h>
#include <zephyr/bluetooth/uuid.h>

#include <zephyr/mgmt/mcumgr/grp/os_mgmt/os_mgmt.h>
#include <zephyr/mgmt/mcumgr/mgmt/callbacks.h>

#include <bluetooth/services/fast_pair/fast_pair.h>
#include <bluetooth/services/fast_pair/fmdn.h>

#include "app_battery.h"
#include "app_factory_reset.h"
#include "app_fp_adv.h"
#include "app_ring.h"
#include "app_ui.h"
#include "app_smp_adv_prov.h"

#include <zephyr/logging/log.h>
LOG_MODULE_REGISTER(fp_fmdn, LOG_LEVEL_INF);

/* Bluetooth identity used by the Fast Pair and FMDN modules.*/
#define APP_BT_ID 1

/* Semaphore timeout in seconds. */
#define INIT_SEM_TIMEOUT (60)

/* Factory reset delay in seconds since the trigger operation. */
#define FACTORY_RESET_DELAY (3)

/* FMDN provisioning timeout in minutes as recommended by the specification. */
#define FMDN_PROVISIONING_TIMEOUT (5)

/* FMDN recovery mode timeout in minutes. */
#define FMDN_RECOVERY_MODE_TIMEOUT (CONFIG_BT_FAST_PAIR_FMDN_READ_MODE_FMDN_RECOVERY_TIMEOUT)

/* FMDN identification mode timeout in minutes. */
#define FMDN_ID_MODE_TIMEOUT (CONFIG_DULT_ID_READ_STATE_TIMEOUT)

/* FMDN DFU mode timeout in minutes. */
#define DFU_MODE_TIMEOUT (1)

/* Minimum button hold time in milliseconds to trigger the FMDN recovery mode. */
#define FMDN_RECOVERY_MODE_BTN_MIN_HOLD_TIME_MS (3000)

/* FMDN advertising interval 2s (0x0C80 in hex). */
#define FMDN_ADV_INTERVAL (0x0C80)

/* TODO:
 * Theoretically COULD be replaced with the "#include <bluetooth/services/dfu_smp.h>"
 * but we do not use this service as we use the "zephyr/subsys/mgmt/mcumgr/transport/src/smp_bt.c"
 * instead.
 * Currently there is no header with the UUID at the Zephyr level.
 * Maybe it should be moved at the Zephyr level from smp_bt.c to the "zephyr/mgmt/mcumgr/transport/smp_bt.h".
 */

/* UUID of the SMP characteristic used for the DFU. */
#define BT_UUID_SMP_CHAR_VAL	\
	BT_UUID_128_ENCODE(0xda2e7828, 0xfbce, 0x4e01, 0xae9e, 0x261174997c48)

#define BT_UUID_SMP_CHAR	BT_UUID_DECLARE_128(BT_UUID_SMP_CHAR_VAL)

/* Factory reset reason. */
enum factory_reset_trigger {
	FACTORY_RESET_TRIGGER_NONE,
	FACTORY_RESET_TRIGGER_KEY_STATE_MISMATCH,
	FACTORY_RESET_TRIGGER_PROVISIONING_TIMEOUT,
};

static bool fmdn_provisioned;
static bool fmdn_recovery_mode;
static bool fmdn_id_mode;
static bool dfu_mode;
static bool fp_account_key_present;

static bool factory_reset_executed;
static enum factory_reset_trigger factory_reset_trigger;

static void init_work_handle(struct k_work *w);

static K_SEM_DEFINE(init_work_sem, 0, 1);
static K_WORK_DEFINE(init_work, init_work_handle);

static void dfu_mode_timeout_work_handle(struct k_work *w);

static K_WORK_DELAYABLE_DEFINE(dfu_mode_timeout_work, dfu_mode_timeout_work_handle);

static void fmdn_factory_reset_executed(void)
{
	/* Clear the trigger state for the scheduled factory reset operations. */
	factory_reset_trigger = FACTORY_RESET_TRIGGER_NONE;
	factory_reset_executed = true;
}

static void fmdn_factory_reset_schedule(enum factory_reset_trigger trigger, k_timeout_t delay)
{
	app_factory_reset_schedule(delay, fmdn_factory_reset_executed);
	factory_reset_trigger = trigger;
}

static void fmdn_factory_reset_cancel(void)
{
	app_factory_reset_cancel();
	factory_reset_trigger = FACTORY_RESET_TRIGGER_NONE;
}

static enum bt_security_err pairing_accept(struct bt_conn *conn,
					   const struct bt_conn_pairing_feat *const feat)
{
	ARG_UNUSED(conn);
	ARG_UNUSED(feat);

	/* Fast Pair Implementation Guidelines for the locator tag use case:
	 * Provider should reject normal Bluetooth pairing attempts. It should
	 * only accept Fast Pair pairing.
	 */

	LOG_WRN("Normal Bluetooth pairing not allowed");

	return BT_SECURITY_ERR_PAIR_NOT_ALLOWED;
}

static const struct bt_conn_auth_cb conn_auth_callbacks = {
	.pairing_accept = pairing_accept,
};

static void print_characteristic_uuid(const struct bt_uuid *uuid)
{
	char uuid_str[37];

	bt_uuid_to_str(uuid, uuid_str, sizeof(uuid_str));
	LOG_DBG("Characteristic UUID: %s", uuid_str);
}

static bool identifying_info_allow(struct bt_conn *conn)
{
	ARG_UNUSED(conn);

	if (!fmdn_provisioned) {
		return true;
	}

	if (fmdn_id_mode) {
		return true;
	}

	LOG_INF("Rejecting operation on the identifying information");

	return false;
}

static bool gatt_authorize(struct bt_conn *conn, const struct bt_gatt_attr *attr)
{
	const struct bt_uuid *uuid_block_list[] = {
		/* GAP service characteristics */
		BT_UUID_GAP_DEVICE_NAME,
	};

	/* Access to the SMP serivce is allowed only when the DFU mode is active. */
	if (bt_uuid_cmp(attr->uuid, BT_UUID_SMP_CHAR) == 0) {
		print_characteristic_uuid(attr->uuid);

		if (!dfu_mode) {
			LOG_INF("Rejecting operation on the SMP characteristic");

			return false;
		}

		return true;
	}

	for (size_t i = 0; i < ARRAY_SIZE(uuid_block_list); i++) {
		if (bt_uuid_cmp(attr->uuid, uuid_block_list[i]) == 0) {
			/* Fast Pair Implementation Guidelines for the locator tag use case:
			 * The Provider shouldn't expose any identifying information
			 * in an unauthenticated manner (e.g. names or identifiers).
			 */

			print_characteristic_uuid(attr->uuid);

			return identifying_info_allow(conn);
		}
	}

	return true;
}

static const struct bt_gatt_authorization_cb gatt_authorization_callbacks = {
	.read_authorize = gatt_authorize,
	.write_authorize = gatt_authorize,
};

static void fp_account_key_written(struct bt_conn *conn)
{
	LOG_INF("Fast Pair: Account Key write");

	app_fp_adv_mode_set(APP_FP_ADV_MODE_NOT_DISCOVERABLE);

	/* Fast Pair Implementation Guidelines for the locator tag use case:
	 * trigger the reset to factory settings if there is no FMDN
	 * provisioning operation within 5 minutes.
	 */
	if (!fp_account_key_present) {
		fmdn_factory_reset_schedule(
			FACTORY_RESET_TRIGGER_PROVISIONING_TIMEOUT,
			K_MINUTES(FMDN_PROVISIONING_TIMEOUT));

		/* Fast Pair Implementation Guidelines for the locator tag use case:
		 * after the Provider was paired, it should not change its MAC address
		 * till FMDN is provisioned or till 5 minutes passes.
		 */
		app_fp_adv_rpa_rotation_suspend(true);
	}

	fp_account_key_present = bt_fast_pair_has_account_key();
}

static const struct bt_fast_pair_info_cb fp_info_callbacks = {
	.account_key_written = fp_account_key_written,
};

static void fmdn_recovery_mode_exited(void)
{
	LOG_INF("FMDN: recovery mode exited");

	fmdn_recovery_mode = false;
	app_ui_state_change_indicate(APP_UI_STATE_RECOVERY_MODE, fmdn_recovery_mode);
}

static void fmdn_id_mode_exited(void)
{
	LOG_INF("FMDN: identification mode exited");

	fmdn_id_mode = false;
	app_ui_state_change_indicate(APP_UI_STATE_ID_MODE, fmdn_id_mode);
}

static void fmdn_read_mode_exited(enum bt_fast_pair_fmdn_read_mode mode)
{
	switch (mode) {
	case BT_FAST_PAIR_FMDN_READ_MODE_FMDN_RECOVERY:
		fmdn_recovery_mode_exited();
		break;
	case BT_FAST_PAIR_FMDN_READ_MODE_DULT_ID:
		fmdn_id_mode_exited();
		break;
	default:
		/* Unsupported mode: should not happen. */
		__ASSERT_NO_MSG(0);
		break;
	}
}

static const struct bt_fast_pair_fmdn_read_mode_cb fmdn_read_mode_cb = {
	.exited = fmdn_read_mode_exited,
};

static void fmdn_recovery_mode_action_handle(void)
{
	int err;

	if (!fmdn_provisioned) {
		LOG_INF("FMDN: the recovery mode is not available in the "
			"unprovisioned state");
		return;
	}

	if (fmdn_recovery_mode) {
		LOG_INF("FMDN: refreshing the recovery mode timeout");
	} else {
		LOG_INF("FMDN: entering the recovery mode for %d minute(s)",
			FMDN_RECOVERY_MODE_TIMEOUT);
	}

	err = bt_fast_pair_fmdn_read_mode_enter(BT_FAST_PAIR_FMDN_READ_MODE_FMDN_RECOVERY);
	if (err) {
		LOG_ERR("FMDN: failed to enter the recovery mode: err=%d", err);
		return;
	}

	fmdn_recovery_mode = true;
	app_ui_state_change_indicate(APP_UI_STATE_RECOVERY_MODE, fmdn_recovery_mode);
}

static void fmdn_id_mode_action_handle(void)
{
	int err;

	if (!fmdn_provisioned) {
		LOG_INF("FMDN: the identification mode is not available in the "
			"unprovisioned state. "
			"Identifying info can always be read in this state.");
		return;
	}

	if (fmdn_id_mode) {
		LOG_INF("FMDN: refreshing the identification mode timeout");
	} else {
		LOG_INF("FMDN: entering the identification mode for %d minute(s)",
			FMDN_ID_MODE_TIMEOUT);
	}

	err = bt_fast_pair_fmdn_read_mode_enter(BT_FAST_PAIR_FMDN_READ_MODE_DULT_ID);
	if (err) {
		LOG_ERR("FMDN: failed to enter the identification mode: err=%d", err);
		return;
	}

	/* Fast Pair Implementation Guidelines for the locator tag use case:
	 * The Provider shouldn't expose any identifying information
	 * in an unauthenticated manner (e.g. names or identifiers).
	 *
	 * The DULT identification mode is also used to allow reading of Bluetooth
	 * characteristics with identifying information for a limited time in the
	 * provisioned state.
	 */
	fmdn_id_mode = true;
	app_ui_state_change_indicate(APP_UI_STATE_ID_MODE, fmdn_id_mode);
}

static enum mgmt_cb_return smp_cmd_recv(uint32_t event, enum mgmt_cb_return prev_status,
					int32_t *rc, uint16_t *group, bool *abort_more,
					void *data, size_t data_size)
{
	const struct mgmt_evt_op_cmd_arg *cmd_recv;

	if (event != MGMT_EVT_OP_CMD_RECV) {
		LOG_ERR("Spurious event in recv cb: %" PRIu32, event);
		*rc = MGMT_ERR_EUNKNOWN;
		return MGMT_CB_ERROR_RC;
	}

	LOG_DBG("MCUmgr SMP Command Recv Event");

	if (data_size != sizeof(*cmd_recv)) {
		LOG_ERR("Invalid data size in recv cb: %zu (expected: %zu)",
			data_size, sizeof(*cmd_recv));
		*rc = MGMT_ERR_EUNKNOWN;
		return MGMT_CB_ERROR_RC;
	}

	cmd_recv = data;

	/* Ignore commands not related to DFU over SMP. */
	if (!(cmd_recv->group == MGMT_GROUP_ID_IMAGE) &&
	    !((cmd_recv->group == MGMT_GROUP_ID_OS) && (cmd_recv->id == OS_MGMT_ID_RESET))) {
		return MGMT_CB_OK;
	}

	LOG_DBG("MCUmgr %s event", (cmd_recv->group == MGMT_GROUP_ID_IMAGE) ?
		"Image Management" : "OS Management Reset");

	k_work_reschedule(&dfu_mode_timeout_work, K_MINUTES(DFU_MODE_TIMEOUT));

	return MGMT_CB_OK;
}

static struct mgmt_callback cmd_recv_cb = {
	.callback = smp_cmd_recv,
	.event_id = MGMT_EVT_OP_CMD_RECV,
};

static void dfu_init(void)
{
	mgmt_callback_register(&cmd_recv_cb);
}

static void dfu_mode_action_handle(void)
{
	if (dfu_mode) {
		LOG_INF("DFU: refreshing the DFU mode timeout");
	} else {
		LOG_INF("DFU: entering the DFU mode for %d minute(s)",
			DFU_MODE_TIMEOUT);
	}

	k_work_reschedule(&dfu_mode_timeout_work, K_MINUTES(DFU_MODE_TIMEOUT));

	dfu_mode = true;

	app_fp_adv_smp_enable(dfu_mode);
	app_fp_adv_mode_set(fmdn_provisioned ?
			    APP_FP_ADV_MODE_NOT_DISCOVERABLE :
			    APP_FP_ADV_MODE_DISCOVERABLE);

	app_ui_state_change_indicate(APP_UI_STATE_DFU_MODE, dfu_mode);
}

static void dfu_mode_timeout_work_handle(struct k_work *w)
{
	LOG_INF("DFU: timeout expired");

	dfu_mode = false;
	app_fp_adv_smp_enable(dfu_mode);
	app_fp_adv_mode_set(APP_FP_ADV_MODE_OFF);

	app_ui_state_change_indicate(APP_UI_STATE_DFU_MODE, dfu_mode);
}

static void fmdn_mode_request_handle(enum app_ui_request request)
{
	/* It is assumed that the callback executes in the cooperative
	 * thread context as it interacts with the FMDN API.
	 */
	__ASSERT_NO_MSG(!k_is_preempt_thread());
	__ASSERT_NO_MSG(!k_is_in_isr());

	if (request == APP_UI_REQUEST_RECOVERY_MODE_ENTER) {
		fmdn_recovery_mode_action_handle();
	} else if (request == APP_UI_REQUEST_ID_MODE_ENTER) {
		fmdn_id_mode_action_handle();
	} else if (request == APP_UI_REQUEST_DFU_MODE_ENTER) {
		dfu_mode_action_handle();
	}
}

static void fmdn_clock_synced(void)
{
	LOG_INF("FMDN: clock information synchronized with the authenticated Bluetooth peer");

	if (fmdn_provisioned) {
		/* Fast Pair Implementation Guidelines for the locator tag use case:
		 * After a power loss, the device should advertise non-discoverable
		 * Fast Pair frames until the next invocation of read beacon parameters.
		 * This lets the Seeker detect the device and synchronize the clock even
		 * if a significant clock drift occurred.
		 */
		app_fp_adv_mode_set(APP_FP_ADV_MODE_OFF);
	}
}

static void fmdn_provisioning_state_changed(bool provisioned)
{
	static bool is_first_state_changed_cb = true;

	enum app_fp_adv_mode fp_adv_mode;

	LOG_INF("FMDN: state changed to %s",
		provisioned ? "provisioned" : "unprovisioned");

	app_ui_state_change_indicate(APP_UI_STATE_PROVISIONED, provisioned);
	fmdn_provisioned = provisioned;

	/* Fast Pair Implementation Guidelines for the locator tag use case:
	 * cancel the provisioning timeout.
	 */
	if (provisioned &&
	    (factory_reset_trigger == FACTORY_RESET_TRIGGER_PROVISIONING_TIMEOUT)) {
		fmdn_factory_reset_cancel();
		app_fp_adv_rpa_rotation_suspend(false);
	}

	/* Fast Pair Implementation Guidelines for the locator tag use case:
	 * trigger the reset to factory settings on the unprovisioning operation
	 * or on the loss of the Owner Account Key.
	 */
	fp_account_key_present = bt_fast_pair_has_account_key();
	if (fp_account_key_present != provisioned) {
		app_fp_adv_mode_set(APP_FP_ADV_MODE_OFF);

		/* Delay the factory reset operation to allow the local device
		 * to send a response to the unprovisioning command and give
		 * the connected peer necessary time to finalize its operations
		 * and shutdown the connection.
		 */
		fmdn_factory_reset_schedule(
			FACTORY_RESET_TRIGGER_KEY_STATE_MISMATCH,
			K_SECONDS(FACTORY_RESET_DELAY));

		return;
	}

	/* Triggered on the unprovisioning operation. */
	if (factory_reset_executed) {
		LOG_INF("Please press a button to put the device in the Fast Pair discoverable "
			"advertising mode after a reset to factory settings");
		factory_reset_executed = false;

		return;
	}

	/* Select the Fast Pair advertising mode according to the FMDN provisioning state. */
	if (provisioned) {
		if (is_first_state_changed_cb) {
			fp_adv_mode = APP_FP_ADV_MODE_NOT_DISCOVERABLE;
		} else {
			fp_adv_mode = APP_FP_ADV_MODE_OFF;
		}
	} else {
		fp_adv_mode = APP_FP_ADV_MODE_DISCOVERABLE;
	}
	app_fp_adv_mode_set(fp_adv_mode);

	is_first_state_changed_cb = false;
}

static struct bt_fast_pair_fmdn_info_cb fmdn_info_cb = {
	.clock_synced = fmdn_clock_synced,
	.provisioning_state_changed = fmdn_provisioning_state_changed,
};

static int fast_pair_prepare(void)
{
	int err;

	err = app_fp_adv_id_set(APP_BT_ID);
	if (err) {
		LOG_ERR("Fast Pair: app_fp_adv_id_set failed (err %d)", err);
		return err;
	}

	err = app_fp_adv_init();
	if (err) {
		LOG_ERR("Fast Pair: app_fp_adv_init failed (err %d)", err);
		return err;
	}

	return 0;
}

static int fmdn_prepare(void)
{
	int err;
	const struct bt_fast_pair_fmdn_adv_param fmdn_adv_param =
		BT_FAST_PAIR_FMDN_ADV_PARAM_INIT(
			FMDN_ADV_INTERVAL, FMDN_ADV_INTERVAL);

	err = bt_fast_pair_fmdn_id_set(APP_BT_ID);
	if (err) {
		LOG_ERR("FMDN: bt_fast_pair_fmdn_id_set failed (err %d)", err);
		return err;
	}

	/* Application configuration of the advertising interval is equal to
	 * the default value that is defined in the FMDN module. This API
	 * call is only for demonstration purposes.
	 */
	err = bt_fast_pair_fmdn_adv_param_set(&fmdn_adv_param);
	if (err) {
		LOG_ERR("FMDN: bt_fast_pair_fmdn_adv_param_set failed (err %d)", err);
		return err;
	}

	err = bt_fast_pair_fmdn_info_cb_register(&fmdn_info_cb);
	if (err) {
		LOG_ERR("FMDN: bt_fast_pair_fmdn_info_cb_register failed (err %d)", err);
		return err;
	}

	err = bt_fast_pair_fmdn_read_mode_cb_register(&fmdn_read_mode_cb);
	if (err) {
		LOG_ERR("FMDN: bt_fast_pair_fmdn_read_mode_cb_register failed (err %d)", err);
		return err;
	}

	err = bt_fast_pair_info_cb_register(&fp_info_callbacks);
	if (err) {
		LOG_ERR("FMDN: bt_fast_pair_info_cb_register failed (err %d)", err);
		return err;
	}

	return 0;
}

static int app_id_create(void)
{
	int ret;
	size_t count;

	BUILD_ASSERT(CONFIG_BT_ID_MAX > APP_BT_ID);

	/* Check if application identity wasn't already created. */
	bt_id_get(NULL, &count);
	if (count > APP_BT_ID) {
		return 0;
	}

	/* Create the application identity. */
	do {
		ret = bt_id_create(NULL, NULL);
		if (ret < 0) {
			return ret;
		}
	} while (ret != APP_BT_ID);

	return 0;
}

static void init_work_handle(struct k_work *w)
{
	int err;

	err = app_ui_init();
	if (err) {
		LOG_ERR("UI module init failed (err %d)", err);
		return;
	}

	err = bt_conn_auth_cb_register(&conn_auth_callbacks);
	if (err) {
		LOG_ERR("Registering authentication callbacks failed (err %d)", err);
		return;
	}

	err = bt_gatt_authorization_cb_register(&gatt_authorization_callbacks);
	if (err) {
		LOG_ERR("Registering GATT authorization callbacks failed (err %d)", err);
		return;
	}

	err = bt_enable(NULL);
	if (err) {
		LOG_ERR("Bluetooth init failed (err %d)", err);
		return;
	}
	LOG_INF("Bluetooth initialized");

	err = settings_load();
	if (err) {
		LOG_ERR("Settings load failed (err: %d)", err);
		return;
	}
	LOG_INF("Settings loaded");

	err = app_id_create();
	if (err) {
		LOG_ERR("Application identity failed to create (err %d)", err);
		return;
	}

	err = app_battery_init();
	if (err) {
		LOG_ERR("FMDN: app_battery_init failed (err %d)", err);
		return;
	}

	if (!IS_ENABLED(CONFIG_BT_FAST_PAIR_FMDN_RING_COMP_NONE)) {
		err = app_ring_init();
		if (err) {
			LOG_ERR("FMDN: app_ring_init failed (err %d)", err);
			return;
		}
	}

	err = fast_pair_prepare();
	if (err) {
		LOG_ERR("FMDN: fast_pair_prepare failed (err %d)", err);
		return;
	}

	err = fmdn_prepare();
	if (err) {
		LOG_ERR("FMDN: fmdn_prepare failed (err %d)", err);
		return;
	}

	err = app_factory_reset_init();
	if (err) {
		LOG_ERR("FMDN: app_factory_reset_init failed (err %d)", err);
		return;
	}

	err = bt_fast_pair_enable();
	if (err) {
		LOG_ERR("FMDN: bt_fast_pair_enable failed (err %d)", err);
		return;
	}

	dfu_init();

	k_sem_give(&init_work_sem);
}

int main(void)
{
	int err;

	LOG_INF("Starting Bluetooth Fast Pair locator tag example");

#ifdef CONFIG_BOOTLOADER_MCUBOOT
	LOG_INF("Firmware version: %s", CONFIG_MCUBOOT_IMGTOOL_SIGN_VERSION);
#endif

	/* Switch to the cooperative thread context before interaction
	 * with the Fast Pair and FMDN API.
	 */
	(void) k_work_submit(&init_work);
	err = k_sem_take(&init_work_sem, K_SECONDS(INIT_SEM_TIMEOUT));
	if (err) {
		k_panic();
		return 0;
	}

	LOG_INF("Sample has started");

	app_ui_state_change_indicate(APP_UI_STATE_APP_RUNNING, true);

	return 0;
}

APP_UI_REQUEST_LISTENER_REGISTER(fmdn_mode_request_handler, fmdn_mode_request_handle);
```

## include/app_fp_adv.h
```c
/*
 * Copyright (c) 2024 Nordic Semiconductor ASA
 *
 * SPDX-License-Identifier: LicenseRef-Nordic-5-Clause
 */

#ifndef APP_FP_ADV_H_
#define APP_FP_ADV_H_

#include <stdint.h>

/**
 * @defgroup fmdn_sample_fp_adv Locator Tag sample Fast Pair advertising module
 * @brief Locator Tag sample Fast Pair advertising module
 *
 * @{
 */

#ifdef __cplusplus
extern "C" {
#endif

/** Fast Pair advertising mode. */
enum app_fp_adv_mode {
	/* Turned off mode. */
	APP_FP_ADV_MODE_OFF,

	/* Discoverable mode. */
	APP_FP_ADV_MODE_DISCOVERABLE,

	/* Not Discoverable mode. */
	APP_FP_ADV_MODE_NOT_DISCOVERABLE,
};

void app_fp_adv_smp_enable(bool enable);

/** Set the Fast Pair advertising mode.
 *
 * @param adv_mode Fast Pair advertising mode.
 */
void app_fp_adv_mode_set(enum app_fp_adv_mode adv_mode);

/** Set the suspension mode for the RPA rotations of the Fast Pair advertising set.
 *
 *  @param suspended true if the RPA cannot change on the RPA timeout.
 *                   false if the RPA can change on the RPA timeout (default).
 */
void app_fp_adv_rpa_rotation_suspend(bool suspended);

/** Set the Bluetooth identity for the Fast Pair advertising.
 *
 *  This identity shall be created with the @ref bt_id_create function
 *  that is available in the Bluetooth API.
 *  You can only set the Bluetooth identity when the Fast Pair advertising
 *  module is uninitialized. If you do not explicitly set the identity with
 *  this API call, the @ref BT_ID_DEFAULT identity is used.
 *
 *  @param id Bluetooth identity for the Fast Pair advertising.
 *
 *  @return 0 if the operation was successful. Otherwise, a (negative) error code is returned.
 */
int app_fp_adv_id_set(uint8_t id);

/** Get the Bluetooth identity used for the Fast Pair advertising.
 *
 *  @return Bluetooth identity for the Fast Pair advertising.
 */
uint8_t app_fp_adv_id_get(void);

/** Uninitialize the Fast Pair advertising module.
 *
 * @return 0 if the operation was successful. Otherwise, a (negative) error code is returned.
 */
int app_fp_adv_uninit(void);

/** Initialize the Fast Pair advertising module.
 *
 * @return 0 if the operation was successful. Otherwise, a (negative) error code is returned.
 */
int app_fp_adv_init(void);

/** Check if the Fast Pair advertising module is initialized.
 *
 *  @return true when the module is initialized, false otherwise.
 */
bool app_fp_adv_is_init(void);

#ifdef __cplusplus
}
#endif

/**
 * @}
 */

#endif /* APP_FP_ADV_H_ */
```

## include/app_smp_adv_prov.h
```c
/*
 * Copyright (c) 2023 Nordic Semiconductor ASA
 *
 * SPDX-License-Identifier: LicenseRef-Nordic-5-Clause
 */

#ifndef APP_SMP_ADV_PROV_H_
#define APP_SMP_ADV_PROV_H_

#include <stdbool.h>

/**
 * @defgroup app_smp_adv_prov SMP advertising data provider API
 * @brief SMP advertising data provider API
 *
 * @{
 */

#ifdef __cplusplus
extern "C" {
#endif

/* Due to using legacy advertising set size, add SMP UUID to either AD or SD,
 * depending on the space availability related to the provisioning state.
 * Otherwise, the advertising set size would be exceeded and the advertising
 * would not start.
 */
void app_smp_adv_prov_ad_enable(void);
void app_smp_adv_prov_sd_enable(void);
void app_smp_adv_prov_disable(void);

#ifdef __cplusplus
}
#endif

/**
 * @}
 */

#endif /* APP_SMP_ADV_PROV_H_ */
```

## src/fp_adv.c
```c
/*
 * Copyright (c) 2024 Nordic Semiconductor ASA
 *
 * SPDX-License-Identifier: LicenseRef-Nordic-5-Clause
 */

#include <zephyr/kernel.h>
#include <zephyr/random/random.h>

#include <zephyr/bluetooth/conn.h>
#include <zephyr/bluetooth/hci.h>
#include <zephyr/bluetooth/hci_vs.h>

#include <bluetooth/adv_prov.h>
#include <bluetooth/adv_prov/fast_pair.h>
#include <bluetooth/services/fast_pair/fast_pair.h>
#include <bluetooth/services/fast_pair/fmdn.h>

#include "app_fp_adv.h"
#include "app_ui.h"
#include "app_smp_adv_prov.h"

#include <zephyr/logging/log.h>
LOG_MODULE_DECLARE(fp_fmdn, LOG_LEVEL_INF);

/* Fast Pair advertising interval 100ms. */
#define FP_ADV_INTERVAL (0x00A0)

/* Rotation period configuration for Fast Pair advertitising. */
#define FP_RPA_SEC_PER_MIN		(60U)
#define FP_RPA_TIMEOUT			(13 * FP_RPA_SEC_PER_MIN)
#define FP_RPA_TIMEOUT_OFFSET_MAX	(2 * FP_RPA_SEC_PER_MIN)

static bool fmdn_provisioned;
static bool dfu_mode;

static struct bt_conn *fp_conn;
static struct bt_le_ext_adv *fp_adv_set;
static bool fp_adv_rpa_rotation_suspended;
static enum app_fp_adv_mode fp_adv_mode = APP_FP_ADV_MODE_OFF;
static const char * const fp_adv_mode_description[] = {
	[APP_FP_ADV_MODE_OFF] = "disabled",
	[APP_FP_ADV_MODE_DISCOVERABLE] = "discoverable",
	[APP_FP_ADV_MODE_NOT_DISCOVERABLE] = "non-discoverable",
};

/* According to Fast Pair specification, the advertising interval should be no longer than
 * 100 ms when discoverable and no longer than 250 ms when not discoverable.
 */
static struct bt_le_adv_param fp_adv_param = {
	.id = BT_ID_DEFAULT,
	.options = (BT_LE_ADV_OPT_CONNECTABLE | BT_LE_ADV_OPT_ONE_TIME),
	.interval_min = FP_ADV_INTERVAL,
	.interval_max = FP_ADV_INTERVAL,
};

static void fp_adv_restart_work_handle(struct k_work *w);

static K_WORK_DEFINE(fp_adv_restart_work, fp_adv_restart_work_handle);

static uint16_t fp_adv_rpa_timeout_calculate(void)
{
	int err;
	int8_t rand;
	uint16_t rpa_timeout = FP_RPA_TIMEOUT;

	err = sys_csrand_get(&rand, sizeof(rand));
	if (!err) {
		int16_t rand_timeout_diff;

		rand_timeout_diff = (((int)(FP_RPA_TIMEOUT_OFFSET_MAX * MSEC_PER_SEC)) / INT8_MAX);
		rand_timeout_diff *= rand;
		rand_timeout_diff /= ((int) MSEC_PER_SEC);

		rpa_timeout += rand_timeout_diff;
	} else {
		LOG_WRN("Fast Pair: cannot get random RPA timeout (err: %d). Used fixed value",
			err);
	}

	return rpa_timeout;
}

static void bond_cnt_cb(const struct bt_bond_info *info, void *user_data)
{
	size_t *cnt = user_data;

	(*cnt)++;
}

static size_t bond_cnt(void)
{
	size_t cnt = 0;

	bt_foreach_bond(fp_adv_param.id, bond_cnt_cb, &cnt);

	return cnt;
}

static bool can_pair(void)
{
	return (bond_cnt() < CONFIG_BT_MAX_PAIRED);
}

static bool fp_adv_is_pairing_mode(enum app_fp_adv_mode fp_adv_mode)
{
	return ((fp_adv_mode == APP_FP_ADV_MODE_DISCOVERABLE) && can_pair());
}

static void fp_adv_prov_configure(enum app_fp_adv_mode fp_adv_mode)
{
	bt_le_adv_prov_fast_pair_enable(can_pair());

	switch (fp_adv_mode) {
	case APP_FP_ADV_MODE_DISCOVERABLE:
		dfu_mode ? app_smp_adv_prov_ad_enable() : app_smp_adv_prov_disable();
		break;

	case APP_FP_ADV_MODE_NOT_DISCOVERABLE:
		dfu_mode ? app_smp_adv_prov_sd_enable() : app_smp_adv_prov_disable();
		bt_le_adv_prov_fast_pair_enable(true);
		bt_le_adv_prov_fast_pair_show_ui_pairing(false);
		break;

	default:
		/* Should not happen. */
		__ASSERT_NO_MSG(false);
		break;
	};
}

static int fp_adv_payload_set(bool rpa_rotated, bool new_session)
{
	int err;
	uint8_t adv_handle;
	struct bt_le_adv_prov_adv_state state = {0};
	struct bt_le_adv_prov_feedback fb = {0};
	size_t ad_len = bt_le_adv_prov_get_ad_prov_cnt();
	size_t sd_len = bt_le_adv_prov_get_sd_prov_cnt();
	struct bt_data ad[ad_len];
	struct bt_data sd[sd_len];

	/* Set advertising mode of Fast Pair advertising data provider. */
	fp_adv_prov_configure(fp_adv_mode);

	state.pairing_mode = fp_adv_is_pairing_mode(fp_adv_mode);
	state.rpa_rotated = rpa_rotated;
	state.new_adv_session = new_session;

	err = bt_hci_get_adv_handle(fp_adv_set, &adv_handle);
	if (err) {
		LOG_ERR("Fast Pair: cannot get advertising handle (err: %d)", err);
		return err;
	}
	/* The TX power advertising provider reads the power for the first advertising set.
	 * This logic verifies that the Fast Pair advertising set has the correct index
	 * and has been created as a first one with the bt_le_ext_adv_create() API.
	 */
	__ASSERT(adv_handle == 0, "Fast Pair: invalid advertising handle: 0x%02X", adv_handle);

	err = bt_le_adv_prov_get_ad(ad, &ad_len, &state, &fb);
	if (err) {
		LOG_ERR("Fast Pair: cannot get advertising data (err: %d)", err);
		return err;
	}

	err = bt_le_adv_prov_get_sd(sd, &sd_len, &state, &fb);
	if (err) {
		LOG_ERR("Fast Pair: cannot get scan response data (err: %d)", err);
		return err;
	}

	err = bt_le_ext_adv_set_data(fp_adv_set, ad, ad_len, sd, sd_len);
	if (err) {
		LOG_ERR("Fast Pair: bt_le_ext_adv_set_data returned error: %d", err);
		return err;
	}

	return 0;
}

static int fp_adv_start_internal(void)
{
	int err;
	struct bt_le_ext_adv_start_param ext_adv_start_param = {0};

	err = bt_le_ext_adv_stop(fp_adv_set);
	if (err) {
		LOG_ERR("Fast Pair: cannot stop advertising (err: %d)", err);
		return err;
	}

	if (fp_adv_mode == APP_FP_ADV_MODE_OFF) {
		return 0;
	}

	err = fp_adv_payload_set(false, true);
	if (err) {
		LOG_ERR("Fast Pair: cannot set advertising payload (err: %d)", err);
		return err;
	}

	err = bt_le_ext_adv_start(fp_adv_set, &ext_adv_start_param);
	if (err) {
		LOG_ERR("Fast Pair: bt_le_ext_adv_start returned error: %d", err);
		return err;
	}

	return 0;
}

static void fp_advertising_start(void)
{
	int err;

	if (!fp_adv_set) {
		/* Advertising set is not prepared yet. */
		return;
	}

	if (fp_conn) {
		/* Only one Fast Pair connection is supported. */
		return;
	}

	err = fp_adv_start_internal();
	if (!err) {
		app_ui_state_change_indicate(APP_UI_STATE_FP_ADV,
					     (fp_adv_mode != APP_FP_ADV_MODE_OFF));

		LOG_INF("Fast Pair: advertising in the %s mode",
			fp_adv_mode_description[fp_adv_mode]);
	} else {
		app_ui_state_change_indicate(APP_UI_STATE_FP_ADV, false);

		LOG_ERR("Fast Pair: advertising failed to start (err %d)", err);
	}
}

static void fp_adv_connected(struct bt_le_ext_adv *adv, struct bt_le_ext_adv_connected_info *info)
{
	__ASSERT_NO_MSG(!fp_conn);

	app_ui_state_change_indicate(APP_UI_STATE_FP_ADV, false);

	fp_conn = info->conn;
}

static bool fp_adv_rpa_expired(struct bt_le_ext_adv *adv)
{
	int err;
	uint16_t next_rpa_timeout;
	static int64_t uptime;
	bool expire_rpa = true;

	/* It is assumed that the callback executes in the cooperative
	 * thread context as it interacts with the FMDN operations.
	 */
	__ASSERT_NO_MSG(!k_is_preempt_thread());
	__ASSERT_NO_MSG(!k_is_in_isr());

	LOG_INF("Fast Pair: RPA expired");

	if (!uptime) {
		uptime = k_uptime_get();
	} else {
		LOG_INF("Fast Pair: the last timeout has occurred %" PRId64 " [s] ago",
			(k_uptime_delta(&uptime) / MSEC_PER_SEC));
	}

	/* In the FMDN provisioned state, the FMDN advertising set is responsible
	 * for setting the global RPA timeout using the bt_le_set_rpa_timeout API.
	 * In the unprovisioned state, it is the responsibility of the Fast Pair advertising set.
	 */
	if (!fmdn_provisioned) {
		next_rpa_timeout = fp_adv_rpa_timeout_calculate();
		err = bt_le_set_rpa_timeout(next_rpa_timeout);
		if (err && (err != -EALREADY)) {
			LOG_ERR("Fast Pair: bt_le_set_rpa_timeout failed: %d for %d [s]",
				err, next_rpa_timeout);
		} else {
			LOG_INF("Fast Pair: setting RPA timeout to %d [s]",
				next_rpa_timeout);
		}
	}

	if (fp_adv_mode == APP_FP_ADV_MODE_DISCOVERABLE) {
		LOG_INF("Fast Pair: RPA rotation blocked for the discoverable advertising");

		expire_rpa = false;
	}

	if (fp_adv_rpa_rotation_suspended) {
		LOG_INF("Fast Pair: RPA rotation is in the suspended mode");

		expire_rpa = false;
	}

	if (fp_adv_mode != APP_FP_ADV_MODE_OFF) {
		err = fp_adv_payload_set(expire_rpa, false);
		if (err) {
			LOG_ERR("Fast Pair: cannot set advertising payload (err: %d)", err);
		}
	}

	return expire_rpa;
}

static int fp_adv_set_setup(void)
{
	int err;
	struct bt_le_oob oob;
	static const struct bt_le_ext_adv_cb fp_adv_set_cb = {
		.connected = fp_adv_connected,
		.rpa_expired = fp_adv_rpa_expired,
	};

	__ASSERT(!fp_adv_set, "Fast Pair: invalid state of the advertising set");

	/* Create the Fast Pair advertising set. */
	err = bt_le_ext_adv_create(&fp_adv_param, &fp_adv_set_cb, &fp_adv_set);
	if (err) {
		LOG_ERR("Fast Pair: bt_le_ext_adv_create returned error: %d", err);
		return err;
	}

	/* Force the RPA rotation to synchronize the Fast Pair advertising
	 * payload with its RPA address using rpa_expired callback.
	 */
	err = bt_le_oob_get_local(fp_adv_param.id, &oob);
	if (err) {
		LOG_ERR("Fast Pair: bt_le_oob_get_local failed: %d", err);
		return err;
	}

	LOG_INF("Fast Pair: prepared the advertising set");

	return 0;
}

static int fp_adv_set_teardown(void)
{
	int err;

	__ASSERT(fp_adv_set, "Fast Pair: invalid state of the advertising set");

	err = bt_le_ext_adv_delete(fp_adv_set);
	if (err) {
		LOG_ERR("Fast Pair: bt_le_ext_adv_delete returned error: %d", err);
		return err;
	}

	fp_adv_set = NULL;

	return 0;
}

static void fp_adv_restart_work_handle(struct k_work *w)
{
	fp_advertising_start();
}

static void fp_adv_conn_clear(void)
{
	int err;

	if (fp_conn) {
		err = bt_conn_disconnect(fp_conn, BT_HCI_ERR_REMOTE_USER_TERM_CONN);
		if (err) {
			LOG_ERR("Fast Pair: bt_conn_disconnect returned error: %d", err);
		}
	}
}

static void connected(struct bt_conn *conn, uint8_t err)
{
	if (err) {
		LOG_WRN("Connection failed (err %" PRIu8 ")", err);

		(void) k_work_submit(&fp_adv_restart_work);
	} else {
		LOG_INF("Connected");
	}
}

static void disconnected(struct bt_conn *conn, uint8_t reason)
{
	LOG_INF("Disconnected (reason %" PRIu8 ")", reason);

	if (fp_conn == conn) {
		fp_conn = NULL;
		(void) k_work_submit(&fp_adv_restart_work);
	}
}

static void security_changed(struct bt_conn *conn, bt_security_t level, enum bt_security_err err)
{
	char addr[BT_ADDR_LE_STR_LEN];

	bt_addr_le_to_str(bt_conn_get_dst(conn), addr, sizeof(addr));

	if (!err) {
		LOG_INF("Security changed: %s level %u", addr, level);
	} else {
		LOG_WRN("Security failed: %s level %u err %d", addr, level, err);
	}
}

BT_CONN_CB_DEFINE(conn_callbacks) = {
	.connected        = connected,
	.disconnected     = disconnected,
	.security_changed = security_changed,
};

static void fp_adv_provisioning_state_changed(bool provisioned)
{
	fmdn_provisioned = provisioned;
}

static struct bt_fast_pair_fmdn_info_cb fmdn_info_cb = {
	.provisioning_state_changed = fp_adv_provisioning_state_changed,
};

void app_fp_adv_mode_set(enum app_fp_adv_mode adv_mode)
{
	fp_adv_mode = adv_mode;

	if (!fp_conn) {
		/* Support only one connection for the Fast Pair advertising set. */
		fp_advertising_start();
	} else {
		LOG_INF("Fast Pair: automatically switched to %s advertising mode",
			fp_adv_mode_description[fp_adv_mode]);
		LOG_INF("Fast Pair: advertising inactive due to an active connection");
	}
}

void app_fp_adv_rpa_rotation_suspend(bool suspended)
{
	fp_adv_rpa_rotation_suspended = suspended;
}

static void fp_adv_request_handle(enum app_ui_request request)
{
	/* It is assumed that the callback executes in the cooperative
	 * thread context as it interacts with the FMDN API.
	 */
	__ASSERT_NO_MSG(!k_is_preempt_thread());
	__ASSERT_NO_MSG(!k_is_in_isr());

	if (!app_fp_adv_is_init()) {
		return;
	}

	if (request == APP_UI_REQUEST_FP_ADV_MODE_CHANGE) {
		bool has_account_key = bt_fast_pair_has_account_key();

		if (has_account_key) {
			switch (fp_adv_mode) {
			case APP_FP_ADV_MODE_OFF:
				fp_adv_mode = APP_FP_ADV_MODE_NOT_DISCOVERABLE;
				break;
			case APP_FP_ADV_MODE_NOT_DISCOVERABLE:
				fp_adv_mode = APP_FP_ADV_MODE_OFF;
				break;
			default:
				__ASSERT_NO_MSG(0);
			}
		} else {
			switch (fp_adv_mode) {
			case APP_FP_ADV_MODE_OFF:
				fp_adv_mode = APP_FP_ADV_MODE_DISCOVERABLE;
				break;
			case APP_FP_ADV_MODE_DISCOVERABLE:
				fp_adv_mode = APP_FP_ADV_MODE_OFF;
				break;
			default:
				__ASSERT_NO_MSG(0);
			}
		}

		fp_advertising_start();
	}
}

void app_fp_adv_smp_enable(bool enable)
{
	dfu_mode = enable;
}

int app_fp_adv_id_set(uint8_t id)
{
	if (app_fp_adv_is_init()) {
		/* It is not possible to switch the Bluetooth identity
		 * if Fast Pair advertising module is operational.
		 */
		return -EACCES;
	}

	fp_adv_param.id = id;

	return 0;
}

uint8_t app_fp_adv_id_get(void)
{
	return fp_adv_param.id;
}

int app_fp_adv_uninit(void)
{
	int err;

	app_fp_adv_mode_set(APP_FP_ADV_MODE_OFF);
	app_fp_adv_rpa_rotation_suspend(false);

	fp_adv_conn_clear();

	err = fp_adv_set_teardown();
	if (err) {
		LOG_ERR("Fast Pair: fp_adv_set_teardown failed (err %d)", err);
		return err;
	}

	return 0;
}

int app_fp_adv_init(void)
{
	int err;

	err = bt_fast_pair_fmdn_info_cb_register(&fmdn_info_cb);
	if (err) {
		LOG_ERR("Fast Pair: bt_fast_pair_fmdn_info_cb_register returned error: %d", err);
		return err;
	}

	err = fp_adv_set_setup();
	if (err) {
		LOG_ERR("Fast Pair: fp_adv_set_setup failed (err %d)", err);
		return err;
	}

	return 0;
}

bool app_fp_adv_is_init(void)
{
	return (fp_adv_set != NULL);
}

APP_UI_REQUEST_LISTENER_REGISTER(fp_adv_request_handler, fp_adv_request_handle);
```

## src/smp_adv_prov.c
```c
/*
 * Copyright (c) 2022 Nordic Semiconductor ASA
 *
 * SPDX-License-Identifier: LicenseRef-Nordic-5-Clause
 */

#include <bluetooth/adv_prov.h>
#include <app_smp_adv_prov.h>

static bool ad_enabled = false;
static bool sd_enabled = false;

void app_smp_adv_prov_ad_enable(void)
{
	ad_enabled = true;
	sd_enabled = false;
}

void app_smp_adv_prov_sd_enable(void)
{
	ad_enabled = false;
	sd_enabled = true;
}

void app_smp_adv_prov_disable(void)
{
	ad_enabled = false;
	sd_enabled = false;
}

static void fill_data(struct bt_data *ad)
{
	static const uint8_t data[] = {
		0x84, 0xaa, 0x60, 0x74, 0x52, 0x8a, 0x8b, 0x86,
		0xd3, 0x4c, 0xb7, 0x1d, 0x1d, 0xdc, 0x53, 0x8d,
	};

	ad->type = BT_DATA_UUID128_ALL;
	ad->data_len = sizeof(data);
	ad->data = data;
}

static int get_ad_data(struct bt_data *ad, const struct bt_le_adv_prov_adv_state *state,
		    struct bt_le_adv_prov_feedback *fb)
{
	if (!ad_enabled) {
		return -ENOENT;
	}

	fill_data(ad);

	return 0;
}

static int get_sd_data(struct bt_data *sd, const struct bt_le_adv_prov_adv_state *state,
		    struct bt_le_adv_prov_feedback *fb)
{
	if (!sd_enabled) {
		return -ENOENT;
	}

	fill_data(sd);

	return 0;
}

/* Used in discoverable adv */
BT_LE_ADV_PROV_AD_PROVIDER_REGISTER(smp_ad, get_ad_data);

/* Used in the not-discoverable adv */
BT_LE_ADV_PROV_SD_PROVIDER_REGISTER(smp_sd, get_sd_data);
```
