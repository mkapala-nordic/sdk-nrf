## Kconfig
```
#
# Copyright (c) 2023 Nordic Semiconductor
#
# SPDX-License-Identifier: LicenseRef-Nordic-5-Clause
#

mainmenu "Nordic ipc_radio firmware"

config IPC_RADIO_BT
	bool "IPC Bluetooth"
	help
	  Enable the IPC Bluetooth radio serialization.

if IPC_RADIO_BT

choice IPC_RADIO_BT_SER
	default IPC_RADIO_BT_HCI_IPC
	prompt "Bluetooth serialization type"
	help
	  Type of the IPC Bluetooth radio serialization used.

config IPC_RADIO_BT_HCI_IPC
	bool "Bluetooth HCI serialization"
	depends on IPC_SERVICE
	depends on IPC_SERVICE_BACKEND_ICBMSG || IPC_SERVICE_BACKEND_RPMSG
	depends on BT_HCI_RAW
	help
	  Use Bluetooth HCI serialization over ipc_service.

endchoice # IPC_RADIO_BT_SER

if IPC_RADIO_BT_HCI_IPC

config QUEUE_THREAD_STACK_SIZE
	int "Queue thread stack size"
	default 512
	help
	  Stack size for the queue thread.

config QUEUE_THREAD_PRIO
	int "Queue thread priority"
	default 7
	help
	  Priority for the queue thread.

endif # IPC_RADIO_BT_HCI_IPC

config SETTINGS
	imply ZMS if SOC_FLASH_NRF_MRAM
	imply NVS if !SOC_FLASH_NRF_MRAM

config BT_MAX_CONN
	default 4 if IPC_RADIO_802154
	default 16 if !IPC_RADIO_802154

endif # IPC_RADIO_BT

module = IPC_RADIO
module-str = "ipc_radio"
source "$(ZEPHYR_BASE)/subsys/logging/Kconfig.template.log_config"

source "Kconfig.zephyr"
```

## prj.conf
```kconfig
#
# Copyright (c) 2023 Nordic Semiconductor
#
# SPDX-License-Identifier: LicenseRef-Nordic-5-Clause
#

# CONFIG_HEAP_MEM_POOL_SIZE=8192
# CONFIG_MAIN_STACK_SIZE=2048
# CONFIG_SYSTEM_WORKQUEUE_STACK_SIZE=2048

# CONFIG_MBOX=y
# CONFIG_IPC_SERVICE=y

# CONFIG_BT=y
# CONFIG_BT_HCI_RAW=y
# CONFIG_BT_MAX_CONN=16

# # CONFIG_ASSERT=y

# CONFIG_IPC_RADIO_BT=y
# CONFIG_IPC_RADIO_BT_HCI_IPC=y

# # CONFIG_BT_CTLR_PHY_CODED=n
# # CONFIG_BT_CENTRAL=n
# CONFIG_BT_PERIPHERAL=y
# CONFIG_BT_EXT_ADV=y
# CONFIG_BT_CTLR_ADV_EXT=y
# CONFIG_BT_CTLR_PHY_CODED=y
# CONFIG_BT_EXT_ADV_CODING_SELECTION=y
# CONFIG_BT_CTLR_ASSERT_HANDLER=y
# CONFIG_BT_USER_PHY_UPDATE=y

# CONFIG_LOG=y
# CONFIG_SERIAL=n
# CONFIG_UART_CONSOLE=n
# CONFIG_LOG=n
# CONFIG_TIMESLICE_SIZE=0

# When zephyr,code-partition points to SRAM (TCM), FLASH_BASE_ADDRESS should be 0
# because the code partition address is already absolute, not relative to flash base
CONFIG_FLASH_BASE_ADDRESS=0

# CONFIG_PM=y
# CONFIG_PM_DEVICE=y
# CONFIG_PM_DEVICE_RUNTIME=y

#####

CONFIG_BT_CENTRAL=n
CONFIG_BT_PERIPHERAL=y

CONFIG_IPC_SERVICE=y
CONFIG_MBOX=y

CONFIG_HEAP_MEM_POOL_SIZE=8192
CONFIG_SYSTEM_WORKQUEUE_STACK_SIZE=2048

# CONFIG_ASSERT=y
# CONFIG_EXCEPTION_STACK_TRACE=y

CONFIG_BT=y
CONFIG_BT_HCI_RAW=y
CONFIG_BT_MAX_CONN=4

# Enable and adjust the below value as necessary
CONFIG_BT_BUF_EVT_RX_COUNT=16
CONFIG_BT_BUF_EVT_RX_SIZE=255
CONFIG_BT_BUF_ACL_RX_SIZE=255
CONFIG_BT_BUF_ACL_TX_SIZE=251
CONFIG_BT_BUF_CMD_TX_SIZE=255

CONFIG_BT_EXT_ADV=y
CONFIG_BT_CTLR_ADV_EXT=y
CONFIG_BT_CTLR_PHY_CODED=y
CONFIG_BT_EXT_ADV_CODING_SELECTION=y
CONFIG_BT_CTLR_ASSERT_HANDLER=y

CONFIG_IPC_RADIO_BT=y
CONFIG_IPC_RADIO_BT_HCI_IPC=y

CONFIG_PM=y
CONFIG_PM_DEVICE=y
CONFIG_PM_DEVICE_RUNTIME=y

CONFIG_CONSOLE=n
CONFIG_UART_CONSOLE=n
CONFIG_SERIAL=n
CONFIG_LOG=n
```

## boards/nrf54h20dk_nrf54h20_cpurad.overlay
```dts
/*
 * Copyright (c) 2025 Nordic Semiconductor ASA
 *
 * SPDX-License-Identifier: LicenseRef-Nordic-5-Clause
 */

// Include common memory map configuration
#include "../../boards/memory_map.overlay"

/{
	chosen {
		zephyr,code-partition = &cpurad_ram0;
		zephyr,sram = &cpurad_data_ram;
		fw-to-relocate = &cpurad_loaded_fw;
	};
};
```

## src/main.c
```c
/*
 * Copyright (c) 2023 Nordic Semiconductor ASA
 *
 * SPDX-License-Identifier: LicenseRef-Nordic-5-Clause
 */

#include <errno.h>
#include <zephyr/logging/log.h>

#include "ipc_bt.h"

LOG_MODULE_REGISTER(ipc_radio, CONFIG_IPC_RADIO_LOG_LEVEL);

int main(void)
{
	int err;

	uintptr_t pc;
	__asm__ volatile("adr %0, ." : "=r"(pc));
	printk("Current PC (program counter) address: 0x%lx\n", (unsigned long)pc);

	err = ipc_bt_init();
	if ((err) && (err != -ENOSYS)) {
		LOG_ERR("Error initializing ipc radio %d", err);
		return err;
	}

	for (;;) {
		err = ipc_bt_process();

		if (err == -ENOSYS) {
			/* Particular implementation does not need the process function */
			return 0;
		} else if (err) {
			LOG_ERR("Error processing ipc radio %d", err);
			return err;
		}
	}
}
```
