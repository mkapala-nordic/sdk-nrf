/*
 * Copyright (c) 2025 Nordic Semiconductor ASA
 *
 * SPDX-License-Identifier: LicenseRef-Nordic-5-Clause
 */

// Include common memory map configuration
#include "../../../boards/memory_map.overlay"

/{
	chosen {
		zephyr,code-partition = &cpurad_loader_partition;
		zephyr,sram = &cpurad_data_ram;
		zephyr,loaded-fw-src = &cpurad_loaded_fw;
		zephyr,loaded-fw-dst = &cpurad_ram0;
	};
};
